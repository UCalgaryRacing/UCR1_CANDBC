VERSION ""

NS_ :

BS_:

BU_:

BO_ 3221225472 VECTOR__INDEPENDENT_SIG_MSG: 0 Vector__XXX
 SG_ NewSignal_0009 : 0|8@1+ (1,0) [0|0] "" Vector__XXX

BO_ 600 FrontAnalog: 16 Vector__XXX
 SG_ Analog1 : 0|16@1+ (1,0) [0|0] "" Vector__XXX
 SG_ Analog2 : 16|16@1+ (1,0) [0|0] "" Vector__XXX
 SG_ Analog3 : 32|16@1+ (1,0) [0|0] "" Vector__XXX
 SG_ Analog4 : 48|16@1+ (1,0) [0|0] "" Vector__XXX
 SG_ Analog5 : 64|16@1+ (1,0) [0|0] "" Vector__XXX
 SG_ Analog6 : 80|16@1+ (1,0) [0|0] "" Vector__XXX
 SG_ Analog7 : 96|16@1+ (1,0) [0|0] "" Vector__XXX
 SG_ Analog8 : 112|16@1+ (1,0) [0|0] "" Vector__XXX

BO_ 600 RearAnalog: 16 Vector__XXX
 SG_ Analog1 : 0|16@1+ (1,0) [0|0] "" Vector__XXX
 SG_ Analog2 : 16|16@1+ (1,0) [0|0] "" Vector__XXX
 SG_ Analog3 : 32|16@1+ (1,0) [0|0] "" Vector__XXX
 SG_ Analog4 : 48|16@1+ (1,0) [0|0] "" Vector__XXX
 SG_ Analog5 : 64|16@1+ (1,0) [0|0] "" Vector__XXX
 SG_ Analog6 : 80|16@1+ (1,0) [0|0] "" Vector__XXX
 SG_ Analog7 : 96|16@1+ (1,0) [0|0] "" Vector__XXX
 SG_ Analog8 : 112|16@1+ (1,0) [0|0] "" Vector__XXX

BO_ 100 FrontFrequency: 16 Vector__XXX
 SG_ Frequency1 : 0|32@1+ (1,0) [0|0] "" Vector__XXX
 SG_ Frequency2 : 32|32@1+ (1,0) [0|0] "" Vector__XXX
 SG_ Frequency3 : 64|32@1+ (1,0) [0|0] "" Vector__XXX
 SG_ Frequency4 : 96|32@1+ (1,0) [0|0] "" Vector__XXX

BO_ 101 RearFrequency: 16 Vector__XXX
 SG_ Frequency1 : 0|32@1+ (1,0) [0|0] "" Vector__XXX
 SG_ Frequency2 : 32|32@1+ (1,0) [0|0] "" Vector__XXX
 SG_ Frequency3 : 64|32@1+ (1,0) [0|0] "" Vector__XXX
 SG_ Frequency4 : 96|32@1+ (1,0) [0|0] "" Vector__XXX

BO_ 1536 FrontAero: 16 Vector__XXX
 SG_ Pressure1 : 0|24@1+ (1,0) [0|0] "" Vector__XXX
 SG_ Pressure2 : 24|24@1+ (1,0) [0|0] "" Vector__XXX
 SG_ Pressure3 : 48|24@1+ (1,0) [0|0] "" Vector__XXX
 SG_ Temperature1 : 72|16@1+ (1,0) [0|0] "" Vector__XXX
 SG_ Temperature2 : 88|16@1+ (1,0) [0|0] "" Vector__XXX
 SG_ Temperature3 : 104|16@1+ (1,0) [0|0] "" Vector__XXX

BO_ 1537 RearAero: 16 Vector__XXX
 SG_ Pressure1 : 0|24@1+ (1,0) [0|0] "" Vector__XXX
 SG_ Pressure2 : 24|24@1+ (1,0) [0|0] "" Vector__XXX
 SG_ Pressure3 : 48|24@1+ (1,0) [0|0] "" Vector__XXX
 SG_ Temperature1 : 72|16@1+ (1,0) [0|0] "" Vector__XXX
 SG_ Temperature2 : 88|16@1+ (1,0) [0|0] "" Vector__XXX
 SG_ Temperature3 : 104|16@1+ (1,0) [0|0] "" Vector__XXX

BA_DEF_  "BusType" STRING ;
BA_DEF_ BO_  "VFrameFormat" ENUM  "StandardCAN","ExtendedCAN","reserved","reserved","reserved","reserved","reserved","reserved","reserved","reserved","reserved","reserved","reserved","reserved","StandardCAN_FD","ExtendedCAN_FD";
BA_DEF_DEF_  "BusType" "";
BA_DEF_DEF_  "VFrameFormat" "StandardCAN";
BA_ "BusType" "CAN FD";
BA_ "VFrameFormat" BO_ 600 14;
BA_ "VFrameFormat" BO_ 600 14;
BA_ "VFrameFormat" BO_ 100 14;
BA_ "VFrameFormat" BO_ 101 14;
BA_ "VFrameFormat" BO_ 1536 14;
BA_ "VFrameFormat" BO_ 1537 14;
