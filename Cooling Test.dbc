VERSION ""

NS_ :

BS_:

BU_:

BO_ 3221225472 VECTOR__INDEPENDENT_SIG_MSG: 0 Vector__XXX
 SG_ NewSignal_0002 : 8|8@1+ (1,0) [0|0] "" Vector__XXX
 SG_ NewSignal_0008 : 96|16@1+ (1,0) [0|0] "" Vector__XXX
 SG_ NewSignal_0007 : 80|16@1+ (1,0) [0|0] "" Vector__XXX
 SG_ NewSignal_0006 : 64|16@1+ (1,0) [0|0] "" Vector__XXX
 SG_ null2 : 96|32@1+ (1,0) [0|0] "" Vector__XXX
 SG_ null1 : 64|16@1+ (1,0) [0|0] "" Vector__XXX
 SG_ null : 32|16@1+ (1,0) [0|0] "" Vector__XXX

BO_ 259 Analog: 16 Vector__XXX
 SG_ Rad1 : 0|16@1+ (1,0) [0|0] "" Vector__XXX
 SG_ Rad2 : 16|16@1+ (1,0) [0|0] "" Vector__XXX
 SG_ Pres1 : 48|16@1+ (1,0) [0|0] "" Vector__XXX
 SG_ Pres2 : 80|16@1+ (1,0) [0|0] "" Vector__XXX

BA_DEF_  "BusType" STRING ;
BA_DEF_ BO_  "VFrameFormat" ENUM  "StandardCAN","ExtendedCAN","reserved","reserved","reserved","reserved","reserved","reserved","reserved","reserved","reserved","reserved","reserved","reserved","StandardCAN_FD","ExtendedCAN_FD";
BA_DEF_DEF_  "BusType" "";
BA_DEF_DEF_  "VFrameFormat" "StandardCAN";
BA_ "BusType" "CAN FD";
BA_ "VFrameFormat" BO_ 259 14;
